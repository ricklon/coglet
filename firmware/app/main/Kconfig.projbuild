## firmware/app/main/Kconfig.projbuild
```kconfig
menu "Coglet"

config OTA_URL
    string "Default agent-hub check-in URL"
    default "http://<your-ota-server>/xiaozhi/ota/"
    help
        Where the robot checks in when no URL has been set with !server.
        Never put an enrollment token in a build that will be published.

endmenu
```

## firmware/app/sdkconfig.defaults
```kconfig
CONFIG_IDF_TARGET="esp32c3"
CONFIG_ESPTOOLPY_FLASHSIZE_4MB=y
CONFIG_PARTITION_TABLE_CUSTOM=y
CONFIG_PARTITION_TABLE_CUSTOM_FILENAME="partitions.csv"
CONFIG_PARTITION_TABLE_OFFSET=0x8000

CONFIG_COMPILER_OPTIMIZATION_SIZE=y
CONFIG_COMPILER_CXX_EXCEPTIONS=y
CONFIG_COMPILER_CXX_EXCEPTIONS_EMG_POOL_SIZE=1024
CONFIG_ESP_MAIN_TASK_STACK_SIZE=8192
CONFIG_ESP_TASK_WDT_TIMEOUT_S=10
CONFIG_ESP_CONSOLE_USB_SERIAL_JTAG=y

# The C3 has no PSRAM: keep Wi-Fi and TLS buffers small (values from the fork).
CONFIG_ESP_WIFI_STATIC_RX_BUFFER_NUM=3
CONFIG_ESP_WIFI_DYNAMIC_RX_BUFFER_NUM=6
CONFIG_ESP_WIFI_RX_BA_WIN=3
CONFIG_ESP_WIFI_IRAM_OPT=n
CONFIG_ESP_WIFI_RX_IRAM_OPT=n
CONFIG_ESP_WIFI_ENABLE_WPA3_SAE=n
CONFIG_ESP_WIFI_ENTERPRISE_SUPPORT=n
CONFIG_LWIP_TCPIP_RECVMBOX_SIZE=16
CONFIG_LWIP_IPV6=n
CONFIG_MBEDTLS_DYNAMIC_BUFFER=y
CONFIG_MBEDTLS_DYNAMIC_FREE_CONFIG_DATA=y
CONFIG_MBEDTLS_SSL_KEEP_PEER_CERTIFICATE=n
CONFIG_MBEDTLS_SSL_RENEGOTIATION=n
CONFIG_FREERTOS_IDLE_TASK_STACKSIZE=768
CONFIG_LIBC_NEWLIB_NANO_FORMAT=y
```
